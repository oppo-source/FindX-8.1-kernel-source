/* Copyright (c) 2014, The Linux Foundation. All rights reserved.
 *
 * This program is free software; you can redistribute it and/or modify
 * it under the terms of the GNU General Public License version 2 and
 * only version 2 as published by the Free Software Foundation.
 *
 * This program is distributed in the hope that it will be useful,
 * but WITHOUT ANY WARRANTY; without even the implied warranty of
 * MERCHANTABILITY or FITNESS FOR A PARTICULAR PURPOSE.  See the
 * GNU General Public License for more details.
 */

/*---------------------------------------------------------------------------
 * This file is autogenerated file using gcdb parser. Please do not edit it.
 * Update input XML file to add a new entry or update variable in this file
 * VERSION = "1.0"
 *---------------------------------------------------------------------------*/
&mdss_mdp {
        dsi_oppo17107_samsung_sofeg01_s_1080p_cmd: qcom,oppo17107_samsung_sofeg01_s_1080p_cmd {
        qcom,mdss-dsi-panel-name = "dsi_oppo17107_samsung_sofeg01_s_1080p_cmd";
 		qcom,mdss-dsi-panel-type = "dsi_cmd_mode";
		qcom,mdss-dsi-virtual-channel-id = <0>;
		qcom,mdss-dsi-stream = <0>;
		qcom,mdss-pan-physical-width-dimension = <74>;
		qcom,mdss-pan-physical-height-dimension = <131>;
		qcom,mdss-dsi-bpp = <24>;
		qcom,mdss-dsi-color-order = "rgb_swap_rgb";
		qcom,mdss-dsi-underflow-color = <0xff>;
		qcom,mdss-dsi-border-color = <0>;
		qcom,mdss-dsi-panel-blackness-level = <1023>;
		qcom,mdss-dsi-traffic-mode = "burst_mode";
		qcom,mdss-dsi-bllp-eof-power-mode;
		qcom,mdss-dsi-bllp-power-mode;
		qcom,mdss-dsi-lane-0-state;
		qcom,mdss-dsi-lane-1-state;
		qcom,mdss-dsi-lane-2-state;
		qcom,mdss-dsi-lane-3-state;
		qcom,mdss-dsi-dma-trigger = "trigger_sw";
		qcom,mdss-dsi-mdp-trigger = "trigger_sw";
		qcom,mdss-dsi-bl-pmic-control-type = "bl_ctrl_dcs";
		qcom,mdss-dsi-reset-sequence = <1 5>, <0 2>, <1 12>;
		qcom,mdss-dsi-bl-max-level = <1023>;
		qcom,adjust-timer-wakeup-ms = <1>;
		qcom,mdss-dsi-te-pin-select = <1>;
		qcom,mdss-dsi-wr-mem-start = <0x2c>;
		qcom,mdss-dsi-wr-mem-continue = <0x3c>;
		qcom,mdss-dsi-te-dcs-command = <1>;
		qcom,mdss-dsi-te-check-enable;
		qcom,mdss-dsi-te-using-te-pin;

		qcom,mdss-dsi-display-timings {
			timing@0{
				qcom,mdss-dsi-panel-framerate = <60>;
				qcom,mdss-dsi-panel-width = <1080>;
				qcom,mdss-dsi-panel-height = <2280>;
				qcom,mdss-dsi-h-front-porch = <80>;
				qcom,mdss-dsi-h-back-porch = <52>;
				qcom,mdss-dsi-h-pulse-width = <20>;
				qcom,mdss-dsi-h-sync-skew = <0>;
				qcom,mdss-dsi-v-back-porch = <16>;
				qcom,mdss-dsi-v-front-porch = <20>;
				qcom,mdss-dsi-v-pulse-width = <4>;
				qcom,mdss-dsi-h-left-border = <0>;
				qcom,mdss-dsi-h-right-border = <0>;
				qcom,mdss-dsi-v-top-border = <0>;
				qcom,mdss-dsi-v-bottom-border = <0>;
				qcom,mdss-dsi-panel-jitter = <0x1 0x1>;

				qcom,mdss-dsi-on-command = [
								05 01 00 00 05 00 02 11 00
								15 01 00 00 01 00 02 35 00
								15 01 00 00 01 00 02 53 20
								39 01 00 00 01 00 03 51 00 00
								39 01 00 00 01 00 02 F7 03
								39 01 00 00 01 00 03 F0 5A 5A
								39 01 00 00 01 00 03 E2 00 85 /*0x41:Seed on + CRC off; 0x85:Seed on+ CRC on */
								39 01 00 00 01 00 02 B0 2C /* CRC LUT */
								39 01 00 00 01 00 16 E2 B4 02 04 05 FF 02 00 00 FF 00 FF FF F0 00 F0 E0 E1 18 FF FA FF
								39 01 00 00 01 00 02 B0 49 /* LBR Enable */
								39 01 00 00 01 00 02 E2 00 /* 0x00: LBR off; 0x01: LBR on */
								39 01 00 00 01 00 02 B0 4A
								39 01 00 00 01 00 02 E2 00 /* 0xFF:255(max); 0x00:0(min) */
								39 01 00 00 01 00 02 B0 4B /* SKIN Enable */
								39 01 00 00 01 00 02 E2 01 /* 0x00: Skin off; 0x01: Skin on */
								39 01 00 00 01 00 02 B0 4C
								39 01 00 00 01 00 02 E2 49 /* 0x01:128(max); 0x80:1(min) */
								39 01 00 00 01 00 03 F0 A5 A5
								05 01 00 00 78 00 02 29 00];
					qcom,mdss-dsi-off-command = [05 01 00 00 28 00 02 28 00
								05 01 00 00 78 00 02 10 00];

				qcom,mdss-dsi-on-command-state = "dsi_lp_mode";
				qcom,mdss-dsi-off-command-state = "dsi_hs_mode";
				qcom,mdss-dsi-h-sync-pulse = <0>;

			};
        };

    };
};
