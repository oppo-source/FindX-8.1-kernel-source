&mdss_mdp {
	dsi_oppo17107_samsung_sofeg02_fhd_dsc_cmd: qcom,dsi_oppo17107_samsung_sofeg02_fhd_dsc_cmd {
		qcom,mdss-dsi-panel-name = "dsi_oppo17107_samsung_sofeg02_fhd_dsc_cmd";
		qcom,mdss-dsi-panel-type = "dsi_cmd_mode";
		qcom,mdss-dsi-virtual-channel-id = <0>;
		qcom,mdss-dsi-stream = <0>;
		qcom,mdss-pan-physical-width-dimension = <68>;
		qcom,mdss-pan-physical-height-dimension = <148>;
		qcom,mdss-dsi-bpp = <24>;
		qcom,mdss-dsi-color-order = "rgb_swap_rgb";
		qcom,mdss-dsi-underflow-color = <0xff>;
		qcom,mdss-dsi-border-color = <0>;
		qcom,mdss-dsi-traffic-mode = "burst_mode";
		qcom,mdss-dsi-bllp-eof-power-mode;
		qcom,mdss-dsi-bllp-power-mode;
		qcom,mdss-dsi-lane-0-state;
		qcom,mdss-dsi-lane-1-state;
		qcom,mdss-dsi-lane-2-state;
		qcom,mdss-dsi-lane-3-state;
		qcom,mdss-dsi-dma-trigger = "trigger_sw";
		qcom,mdss-dsi-mdp-trigger = "trigger_sw";
		qcom,mdss-dsi-bl-pmic-control-type = "bl_ctrl_dcs";
		qcom,mdss-dsi-lp11-init;
		qcom,mdss-dsi-reset-sequence = <1 5>, <0 2>, <1 12>;
		qcom,esd-check-enabled;
		qcom,mdss-dsi-panel-status-read-length = <1>;
		qcom,mdss-dsi-panel-status-check-mode="reg_read";
		qcom,mdss-dsi-panel-status-command = [06 01 00 01 05 00 02 0A 08];
		qcom,mdss-dsi-panel-status-command-state = "dsi_hs_mode";
		qcom,mdss-dsi-panel-status-value = <0x9f>;
		qcom,mdss-dsi-bl-max-level = <1023>;
		qcom,mdss-brightness-max-level = <1023>;
		qcom,adjust-timer-wakeup-ms = <1>;
		qcom,mdss-dsi-te-pin-select = <1>;
		qcom,mdss-dsi-wr-mem-start = <0x2c>;
		qcom,mdss-dsi-wr-mem-continue = <0x3c>;
		qcom,mdss-dsi-te-dcs-command = <1>;
		qcom,mdss-dsi-te-check-enable;
		qcom,mdss-dsi-te-using-te-pin;
		qcom,mdss-dsi-panel-hdr-enabled;
		qcom,mdss-dsi-panel-hdr-color-primaries = <14500 15500 32000
		17000 15500 30000 8000 3000>;
		qcom,mdss-dsi-panel-peak-brightness = <4200000>;
		qcom,mdss-dsi-panel-blackness-level = <3230>;
		qcom,mdss-dsi-display-timings {
			timing@0{
				qcom,mdss-dsi-panel-framerate = <60>;
				//qcom,mdss-dsi-panel-clockrate = <560000000>;
				qcom,mdss-dsi-panel-width = <1080>;
				qcom,mdss-dsi-panel-height = <2340>;
				qcom,mdss-dsi-h-front-porch = <128>;
				qcom,mdss-dsi-h-back-porch = <148>;
				qcom,mdss-dsi-h-pulse-width = <16>;
				qcom,mdss-dsi-h-sync-skew = <0>;
				qcom,mdss-dsi-v-back-porch = <20>;
				qcom,mdss-dsi-v-front-porch = <24>;
				qcom,mdss-dsi-v-pulse-width = <8>;
				qcom,mdss-dsi-h-left-border = <0>;
				qcom,mdss-dsi-h-right-border = <0>;
				qcom,mdss-dsi-v-top-border = <0>;
				qcom,mdss-dsi-v-bottom-border = <0>;
				qcom,mdss-dsi-panel-jitter = <0x4 0x1>;
				qcom,mdss-dsi-on-command = [
						39 01 00 00 03 00 03 F0 5A 5A
						39 01 00 00 00 00 03 FC 5A 5A
						39 01 00 00 00 00 5A 0A 11 00 00 89 30 80 09 24
										04 38 00 3c 02 1c 02 1c
										02 00 02 0e 00 20 05 d2
										00 07 00 0c 01 a1 01 b2
										18 00 10 f0 03 0c 20 00
										06 0b 0b 33 0e 1c 2a 38
										46 54 62 69 70 77 79 7b
										7d 7e 01 02 01 00 09 40
										09 be 19 fc 19 fa 19 f8
										1a 38 1a 78 1a b6 2a f6
										2b 34 2B 74 3B 74 6b f4
										00
						39 01 00 00 00 00 03 FC A5 A5
						39 01 00 00 00 00 03 F0 A5 A5
						05 01 00 00 10 00 02 11 00
						39 01 00 00 00 00 03 FC 5A 5A
						39 01 00 00 00 00 02 B0 09
						39 01 00 00 00 00 02 D7 2A
						39 01 00 00 00 00 02 FE B0
						39 01 00 00 00 00 02 FE 30
						39 01 00 00 00 00 03 FC A5 A5
						39 01 00 00 00 00 03 F0 5A 5A
						39 01 00 00 00 00 02 B0 1B
						39 01 00 00 00 00 02 B5 24
						39 01 00 00 00 00 02 F7 03
						39 01 00 00 00 00 03 F0 A5 A5
						15 01 00 00 01 00 02 35 00
						39 01 00 00 00 00 02 07 01
						39 01 00 00 00 00 03 F0 5A 5A
						39 01 00 00 00 00 02 9D 01
						39 01 00 00 00 00 03 F0 A5 A5
						39 01 00 00 00 00 03 F0 5A 5A
						39 01 00 00 00 00 02 B0 07
						39 01 00 00 00 00 03 B9 11 03
						39 01 00 00 00 00 03 F0 A5 A5
						39 01 00 00 00 00 03 F0 5A 5A
						39 01 00 00 00 00 02 B0 04
						39 01 00 00 00 00 02 F6 A0
						39 01 00 00 00 00 02 F7 03
						39 01 00 00 00 00 03 F0 A5 A5
						39 01 00 00 00 00 03 F0 5A 5A
						39 01 00 00 00 00 02 B0 02
						39 01 00 00 00 00 07 B5 4A 00 12 33 33 33
						39 01 00 00 00 00 03 F0 A5 A5
						39 01 00 00 00 00 03 F0 5A 5A
						39 01 00 00 00 00 02 ED 4C
						39 01 00 00 00 00 03 F0 A5 A5
						05 01 00 00 01 00 02 29 00];
				qcom,mdss-dsi-off-command = [05 01 00 00 1C 00 02 28 00
						05 01 00 00 78 00 02 10 00];
				qcom,mdss-dsi-lp1-command = [        /*add for enter aod*/
						39 01 00 00 00 00 03 F0 5A 5A
						39 01 00 00 00 00 02 B0 1B
						39 01 00 00 00 00 02 B5 28
						39 01 00 00 00 00 02 F7 03
						39 01 00 00 00 00 03 F0 A5 A5
						39 01 00 00 01 00 03 F0 5A 5A
						39 01 00 00 01 00 02 BB 05
						39 01 00 00 01 00 02 53 02
						39 01 00 00 28 00 03 F0 A5 A5];
				qcom,mdss-dsi-nolp-command = [
						39 01 00 00 00 00 03 F0 5A 5A
						39 01 00 00 00 00 02 B0 1B
						39 01 00 00 00 00 02 B5 24
						39 01 00 00 00 00 02 F7 03
						39 01 00 00 00 00 03 F0 A5 A5
						39 01 00 00 01 00 03 F0 5A 5A
						39 01 00 00 01 00 02 BB 05
						39 01 00 00 01 00 02 53 20
						39 01 00 00 60 00 03 F0 A5 A5];
				qcom,mdss-dsi-aod-on-command = [     /*add for aod debug*/
						39 01 00 00 00 00 03 F0 5A 5A
						39 01 00 00 00 00 02 B0 1B
						39 01 00 00 00 00 02 B5 28
						39 01 00 00 00 00 02 F7 03
						39 01 00 00 00 00 03 F0 A5 A5
						39 01 00 00 01 00 03 F0 5A 5A
						39 01 00 00 01 00 02 BB 05
						39 01 00 00 01 00 02 53 02
						39 01 00 00 01 00 03 F0 A5 A5];
				qcom,mdss-dsi-aod-off-command = [    /*add for aod debug*/
						39 01 00 00 00 00 03 F0 5A 5A
						39 01 00 00 00 00 02 B0 1B
						39 01 00 00 00 00 02 B5 24
						39 01 00 00 00 00 02 F7 03
						39 01 00 00 00 00 03 F0 A5 A5
						39 01 00 00 01 00 03 F0 5A 5A
						39 01 00 00 01 00 02 BB 05
						39 01 00 00 01 00 02 53 20
						39 01 00 00 10 00 03 F0 A5 A5];
				qcom,mdss-dsi-hbm-on-command = [
						39 01 00 00 01 00 03 F0 5A 5A
						39 01 00 00 01 00 02 53 E0   /*1 frame enter hbm and 600nit*/
						39 01 00 00 01 00 03 F0 A5 A5];
				qcom,mdss-dsi-hbm-off-command = [
						39 01 00 00 01 00 03 F0 5A 5A
						39 01 00 00 01 00 02 53 20   /*1 frame exit hbm*/
						39 01 00 00 01 00 03 F0 A5 A5];
				qcom,mdss-dsi-seed-dcip3-command = [
						39 01 00 00 01 00 03 F0 5A 5A
						39 01 00 00 01 00 06 80 05 01 11 01 00  /*Seed on + CRC Enable + CRC DCI-P3 + ORE 0 step */
						39 01 00 00 01 00 03 F0 A5 A5];
				qcom,mdss-dsi-seed-srgb-command = [
						39 01 00 00 01 00 03 F0 5A 5A
						39 01 00 00 01 00 06 80 05 01 00 01 00  /*Seed on + CRC Enable + CRC sRGB + ORE 0 step */
						39 01 00 00 01 00 03 F0 A5 A5];
				qcom,mdss-dsi-seed-off-command = [
				        39 01 00 00 01 00 03 F0 5A 5A
						39 01 00 00 01 00 02 80 00   /* SEED OFF */
						39 01 00 00 01 00 03 F0 A5 A5];
				qcom,mdss-dsi-on-command-state = "dsi_hs_mode";
				qcom,mdss-dsi-off-command-state = "dsi_hs_mode";
				qcom,mdss-dsi-lp1-command-state = "dsi_hs_mode";
				qcom,mdss-dsi-nolp-command-state = "dsi_hs_mode";
				qcom,mdss-dsi-seed-dcip3-command-state = "dsi_hs_mode";
				qcom,mdss-dsi-seed-srgb-command-state = "dsi_hs_mode";
				qcom,mdss-dsi-seed-off-command-state = "dsi_hs_mode";
				qcom,mdss-dsi-h-sync-pulse = <0>;
				qcom,compression-mode = "dsc";
				qcom,mdss-dsc-slice-height = <60>;
				qcom,mdss-dsc-slice-width = <540>;
				qcom,mdss-dsc-slice-per-pkt = <2>;
				qcom,mdss-dsc-bit-per-component = <8>;
				qcom,mdss-dsc-bit-per-pixel = <8>;
				qcom,mdss-dsc-block-prediction-enable;
			};
        };
    };
};
