## drivers/input/touchscreen/oppo_touchscreen/Kconfig
```kconfig
config TOUCHPANEL_MTK_PLATFORM
	bool "OPPO platform tp module used"
	help
	  Say Y here if you have mtk-platform.

config TOUCHPANEL_NEW_SET_IRQ_WAKE
	bool "OPPO platform tp module used"
	help
	  Say Y here if call enable_irq_wake, can not call disable_irq_nosync

config TOUCHPANEL_OPPO
	bool "OPPO tp module"
	help
	  Say Y here if you have touchscreen module.

config TOUCHPANEL_MULTI_NOFLASH
	bool "Multiple noflash TPs using"
	help
	  Say Y here if you have multiple noflash touchscreen.

config TOUCHPANEL_SAMSUNG
#	default y
	bool "TP samsung IC enable or not for OPPO"
	---help---
	say Y to enable driver for Touchpanel using samsung IC

if TOUCHPANEL_SAMSUNG
source "drivers/input/touchscreen/oppo_touchscreen/Samsung/Kconfig"
endif
```

## drivers/misc/oppo/Kconfig
```kconfig
menuconfig OPPO_MOTOR
	bool "OPPO motor control system"
	depends on I2C
	select REGMAP_I2C
	help
	  Say Y here to enable OPPO motor control system support

if OPPO_MOTOR

config CAMERA_MOTOR_DRV8834
	tristate "CAMERA MOTOR DRV8834 Controler"
	default n
	help
	  Say Y here to enable DRV8834.

config DIGITAL_HALL_M1120
	tristate "digital hall m1120 Controler"
	default n
	help
	  Say Y here to enable m1120.

endif #OPPO_CHARGER
```

## drivers/misc/oppo_face_drivers/Kconfig
```kconfig
menuconfig OPPO_3D_FACE
	bool "OPPO 3d face"
	depends on SPI_MASTER
	help
	  Say Y here to enable OPPO 3d face support

if OPPO_3D_FACE

config OPPO_3D_FACE_QCOM
       default n
       tristate "3D FACE base on QCOM"

config OPPO_3D_FACE_MTK
       default n
       tristate "3D FACE base on MTK"

endif #OPPO_3D_FACE
```

## drivers/power/Kconfig
```kconfig
source "drivers/power/avs/Kconfig"
source "drivers/power/reset/Kconfig"
source "drivers/power/supply/Kconfig"
source "drivers/power/qcom/Kconfig"

#ifdef VENDOR_EDIT /* Jianchao.Shi@BSP.CHG.Basic, 2018/01/12, sjc Add for charging */
config OPPO_SDM845_CHARGER
	tristate "OPPO SDM845 charger driver"
	depends on MFD_SPMI_PMIC
	help
	  Enables support for the oppo charging framework

config OPPO_SHORT_C_BATT_CHECK
	tristate "OPPO_SHORT_C_BATT CHECK SUPPORT"
	default n
	depends on MFD_SPMI_PMIC
	help
	  Say Y to include support

config OPPO_RTC_DET_SUPPORT
	tristate "OPPO RTC DET SUPPORT"
	default n
	depends on MFD_SPMI_PMIC
	help
	  Say Y to include support

config OPPO_CHECK_CHARGERID_VOLT
	tristate "OPPO CHECK CHARGERID VOLT"
	default n
	depends on MFD_SPMI_PMIC
	help
	  Say Y to include support

config OPPO_SHIP_MODE_SUPPORT
	tristate "OPPO_SHIP_MODE_SUPPORT"
	default n
	depends on MFD_SPMI_PMIC
	help
	  Say Y to include support

config OPPO_SHORT_HW_CHECK
	bool "OPPO batt HW SHORT "
	help
	  Say Y to include support

config OPPO_SHORT_USERSPACE
	bool "OPPO batt userspace"
	help
	  Say Y to include support
source "drivers/power/oppo/Kconfig"
#endif
```

## drivers/power/oppo/Kconfig
```kconfig
menuconfig OPPO_CHARGER
	bool "OPPO charging system"
	depends on I2C
	select REGMAP_I2C
	help
	  Say Y here to enable OPPO charging system support

if OPPO_CHARGER
config OPPO_CHARGER_MTK
	bool "OPPO charger on MTK"
	help
	  Say Y here to declare charging system is on MTK
	  
config OPPO_SHORT_C_BATT_CHECK
	bool "OPPO batt short "
	help
	  Say Y here to declare OPPO batt short	  

config OPPO_STANDARD_BATTERY_CHECK_ADC
	bool "OPPO Official Standard Battery check by ADC"
	help
	  Say Y here to support Official Standard Battery check by ADC

config OPPO_SHORT_HW_CHECK
	bool "OPPO batt HW SHORT "
	help
	  Say Y here to declare charging system is on MTK

config OPPO_SHORT_USERSPACE
	bool "OPPO batt userspace"
	help
	  Say Y to include support
endif #OPPO_CHARGER
```

## drivers/soc/oppo/Kconfig
```kconfig
# ifdef VENDOR_EDIT 
# yixue.ge add for config oppo software common soft
config OPPO_ARCH_FILE
	bool "for build directory oppo"
	---help---
	say Y to buid in

config OPPO_COMMON_SOFT
      bool "config oppo common software"
	  select OPPO_ARCH_FILE
	  help
		define this config to get project verion from sharemem.
		Maybe this value is from CDT or dynamic identify by hardware
		id.

config OPPO_DEVICE_IFNO
      bool "config oppo devinfo"
	  select OPPO_ARCH_FILE
	  help
		define this config to compile devinfo.c for device register
		.
source "drivers/soc/oppo/oppo_project/Kconfig"

source "drivers/soc/oppo/oppo_devinfo/Kconfig"

source "drivers/soc/oppo/oppo_trace/Kconfig"
source "drivers/soc/oppo/oppo_mdmrst/Kconfig"

#ifdef VENDOR_EDIT
#//John.Xu@PhoneSw.AudioDriver, 2016/02/22, Add for critical_log
#source "drivers/soc/oppo/oppo_criticallog/Kconfig"
#endif /* VENDOR_EDIT */


#endif /* VENDOR_EDIT */
```

## drivers/soc/oppo/oppo_devinfo/Kconfig
```kconfig
# ifdef VENDOR_EDIT 
# yixue.ge add for config oppo software devinfo soft
      config OPPO_DEVICE_IFNO
      bool "config oppo devinfo software"
	  help
		define this config to compile devinfo.c for device register
#endif /* VENDOR_EDIT */
```

## drivers/soc/oppo/oppo_hypnus/Kconfig
```kconfig
config OPPO_HYPNUS
bool "config oppo hypnus feature"
help
    This selects hypnus driver
```

## drivers/soc/oppo/oppo_mdmrst/Kconfig
```kconfig
# ifdef VENDOR_EDIT 
# yixue.ge add for config oppo software common soft
config RECORD_MDMRST
bool "config record mdmrst"
help
    define this config to count the modem restart times.
#endif /* VENDOR_EDIT */
```

## drivers/soc/oppo/oppo_trace/Kconfig
```kconfig
# ifdef VENDOR_EDIT 
# yixue.ge add for config oppo software common soft
      config OPPO_DEBUG_ASSERT
      bool "config oppo common software"
	  help
		define this config to get project verion from sharemem.
		Maybe this value is from CDT or dynamic identify by hardware
		id.
#endif /* VENDOR_EDIT */
```
